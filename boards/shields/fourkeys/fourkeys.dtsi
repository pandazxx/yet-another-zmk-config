/*
 * Copyright (c) 2024 MC Technology
 * SPDX-License-Identifier: MIT
 *
 * Experimental 4-key keyboard with analog joystick as mouse.
 * 4 keys wired directly to GPIO (no matrix needed).
 *
 * Pin assignments (adjust to match your actual wiring):
 *   Key 1 → pro_micro pin 4
 *   Key 2 → pro_micro pin 5
 *   Key 3 → pro_micro pin 6
 *   Key 4 → pro_micro pin 7
 *
 * Joystick ADC wiring is defined in the board overlay (e.g. nice_nano_v2.overlay).
 */

#include <dt-bindings/zmk/matrix_transform.h>

/ {
    chosen {
        zmk,kscan = &kscan0;
        zmk,matrix-transform = &default_transform;
    };

    default_transform: keymap_transform_0 {
        compatible = "zmk,matrix-transform";
        columns = <4>;
        rows = <1>;
        // SW1  SW2  SW3  SW4
        map = <
            RC(0,0) RC(0,1) RC(0,2) RC(0,3)
        >;
    };

    kscan0: kscan {
        compatible = "zmk,kscan-gpio-direct";
        wakeup-source;

        // Adjust pin numbers to match your hardware wiring
        input-gpios
            = <&pro_micro 4 (GPIO_ACTIVE_LOW | GPIO_PULL_UP)>   /* Key 1 */
            , <&pro_micro 5 (GPIO_ACTIVE_LOW | GPIO_PULL_UP)>   /* Key 2 */
            , <&pro_micro 6 (GPIO_ACTIVE_LOW | GPIO_PULL_UP)>   /* Key 3 */
            , <&pro_micro 7 (GPIO_ACTIVE_LOW | GPIO_PULL_UP)>   /* Key 4 */
            ;
    };
};
