## boards/shields/4keys/Kconfig.defconfig
```kconfig
# Copyright (c) 2024 MC Technology
# SPDX-License-Identifier: MIT

if SHIELD_4KEYS

config ZMK_KEYBOARD_NAME
    default "4Keys"

endif
```

## boards/shields/4keys/Kconfig.shield
```kconfig
# Copyright (c) 2024 MC Technology
# SPDX-License-Identifier: MIT

config SHIELD_4KEYS
    def_bool $(shields_list_contains,4keys)
```

## boards/shields/field_test/Kconfig.defconfig
```kconfig
# Copyright (c) 2024 Field Test contributors
# SPDX-License-Identifier: MIT

if SHIELD_FIELD_TEST

config ZMK_KEYBOARD_NAME
    default "Field Test"

endif # SHIELD_FIELD_TEST
```

## boards/shields/field_test/Kconfig.shield
```kconfig
# Copyright (c) 2024 Field Test contributors
# SPDX-License-Identifier: MIT

config SHIELD_FIELD_TEST
    def_bool $(shields_list_contains,field_test)
```

## boards/shields/fourkeys/Kconfig.defconfig
```kconfig
# Copyright (c) 2024 MC Technology
# SPDX-License-Identifier: MIT

if SHIELD_FOURKEYS

config ZMK_KEYBOARD_NAME
    default "4Keys"

endif
```

## boards/shields/fourkeys/Kconfig.shield
```kconfig
# Copyright (c) 2024 MC Technology
# SPDX-License-Identifier: MIT

config SHIELD_FOURKEYS
    def_bool $(shields_list_contains,fourkeys)
```

## drivers/input/Kconfig
```kconfig
if INPUT

config INPUT_BB_TRACKBALL
    bool "BlackBerry trackball breakout (4 direction pins)"
    default y
    depends on DT_HAS_ZMK_INPUT_BB_TRACKBALL_ENABLED
    help
      Input driver for the BlackBerry trackball breakout boards that expose
      four hall-effect direction pins (UP / DWN / LFT / RHT), plus an
      optional ball-click button. Each pin pulses while the ball rolls in
      that direction; pulses are counted and reported as relative X/Y.

config INPUT_ANALOG_STICK
    bool "Analog joystick as a pointing device"
    default y
    depends on DT_HAS_ZMK_INPUT_ANALOG_STICK_ENABLED
    select ADC
    help
      Input driver for a two-potentiometer analog joystick. Both axes are
      sampled on a timer and the deflection past a deadzone is reported as
      relative motion, so the stick behaves as a velocity control rather
      than an absolute axis.

endif # INPUT
```

## drivers/input_processor/Kconfig
```kconfig
config ZMK_INPUT_PROCESSOR_ACCELERATION
    bool "Pointer acceleration input processor"
    default y
    depends on DT_HAS_ZMK_INPUT_PROCESSOR_ACCELERATION_ENABLED
    depends on ZMK_POINTING
    help
      Scales relative motion by how fast the pointing device is moving, so
      a slow roll gives a fine step for aiming and a fast one gives a large
      step for crossing the screen. Attach it to a listener with
      input-processors = <&zip_accel MIN_MULT MAX_MULT>.
```

## dts/bindings/input/zmk,input-analog-stick.yaml
```yaml
# SPDX-License-Identifier: MIT

description: |
  Two-potentiometer analog joystick (KY-023 and friends) used as a pointing
  device.

  Deflection is read as a velocity and reported as relative motion, because
  ZMK's input listener ignores INPUT_EV_ABS events. Push the stick further
  and the cursor moves faster; the resting position produces nothing.

compatible: "zmk,input-analog-stick"

include: base.yaml

properties:
  io-channels:
    type: phandle-array
    required: true
    description: |
      Exactly two ADC inputs, X first then Y. On the nRF52840 the cell is the
      AIN number, so <&adc 5> is AIN5 = P0.29.

  btn-gpios:
    type: phandle-array
    description: |
      Optional stick push switch (the SW pin), reported as INPUT_BTN_0 and so
      turned into a left click by the input listener. Usually active low and
      wants a pull-up.

  sampling-hz:
    type: int
    default: 100
    description: |
      How often both axes are sampled. This is a continuously running ADC, so
      it costs battery; lower it if idle drain matters more than smoothness.

  deadzone-mv:
    type: int
    default: 80
    description: |
      Millivolts of slack around the centre that produce no movement. Raise it
      if the cursor creeps when the stick is released; the driver measures
      speed from the edge of the deadzone, so widening it does not add a jump.

  centre-mv:
    type: int
    default: 0
    description: |
      Resting voltage of both axes. Leave at 0 to measure it at startup
      instead, which is usually better than a hardcoded number - just do not
      hold the stick while the board boots.

  scale-multiplier:
    type: int
    default: 1
    description: Numerator of millivolts-to-pixels-per-tick.

  scale-divisor:
    type: int
    default: 40
    description: |
      Denominator of millivolts-to-pixels-per-tick. Lower is faster. Division
      leftovers are carried between ticks, so slow creeping movement survives.

  invert-x:
    type: boolean
    description: Negate the X axis.

  invert-y:
    type: boolean
    description: Negate the Y axis.

  swap-xy:
    type: boolean
    description: Exchange X and Y, e.g. for a stick mounted rotated.
```

## dts/bindings/input/zmk,input-bb-trackball.yaml
```yaml
# SPDX-License-Identifier: MIT

description: |
  BlackBerry trackball breakout board.

  Four hall-effect sensors expose one pin per direction (UP / DWN / LFT / RHT).
  A pin toggles while the ball is rolled in that direction (roughly 9
  transitions per full revolution of the ball, so a large scaler multiplier
  on the input listener is normally required).

  The optional ball-click switch (BTN, active low) is reported as INPUT_BTN_0.

compatible: "zmk,input-bb-trackball"

include: base.yaml

properties:
  up-gpios:
    type: phandle-array
    required: true
    description: UP pin of the breakout.

  down-gpios:
    type: phandle-array
    required: true
    description: DWN pin of the breakout.

  left-gpios:
    type: phandle-array
    required: true
    description: LFT pin of the breakout.

  right-gpios:
    type: phandle-array
    required: true
    description: RHT pin of the breakout.

  btn-gpios:
    type: phandle-array
    description: |
      Optional BTN pin (ball click). Reported as INPUT_BTN_0, i.e. a left
      mouse button, by the input listener. Omit it if you would rather wire
      the switch into your key matrix and bind &mkp in the keymap.

  btn-code:
    type: int
    description: |
      Input code reported for the button, INPUT_BTN_0 (left click) when not
      given. Set it to INPUT_BTN_1 for a right click, which matters when two
      pointing devices are fitted and would otherwise both click left. Needs
      #include <zephyr/dt-bindings/input/input-event-codes.h> in the overlay.

  report-interval-ms:
    type: int
    default: 10
    description: |
      How long pulses are accumulated before a relative report is emitted.
      Lower values feel more responsive, higher values batch more movement
      into a single HID report.

  accel-min-multiplier:
    type: int
    default: 1
    description: |
      Pixels per pulse when the ball is turning slowly, i.e. the finest step
      the pointer can take. Leave at 1 with accel-max-multiplier to disable
      acceleration and scale on the listener instead.

  accel-max-multiplier:
    type: int
    default: 1
    description: |
      Pixels per pulse when the ball is spinning at or beyond
      accel-fast-interval-ms. Must exceed accel-min-multiplier for
      acceleration to engage.

  accel-fast-interval-ms:
    type: int
    default: 20
    description: |
      Pulse spacing at or below which the pointer runs at
      accel-max-multiplier.

  accel-slow-interval-ms:
    type: int
    default: 150
    description: |
      Pulse spacing at or above which the pointer runs at
      accel-min-multiplier. Also what the speed estimate resets to after a
      pause, so a movement always starts at the fine step. Must be greater
      than accel-fast-interval-ms.

  invert-x:
    type: boolean
    description: Negate the X axis (swap the LFT/RHT sense).

  invert-y:
    type: boolean
    description: Negate the Y axis (swap the UP/DWN sense).

  swap-xy:
    type: boolean
    description: Exchange the X and Y axes, e.g. for a rotated module.
```

## dts/bindings/input_processors/zmk,input-processor-acceleration.yaml
```yaml
# SPDX-License-Identifier: MIT

description: |
  Input processor that scales relative motion by how fast the device is
  moving, so one device can have a fine step for aiming and a large step for
  crossing the screen.

  Speed is measured per code in units per second, where a unit is whatever
  the device reports: pulses per second for an incremental device such as a
  trackball, pixels per second for a joystick that already reports a
  velocity. The two multipliers are the processor's cells:

    input-processors = <&zip_accel 8 128>;

compatible: "zmk,input-processor-acceleration"

include: ip_two_param.yaml

properties:
  type:
    type: int
    description: Event type to act on. INPUT_EV_REL when omitted.

  codes:
    type: array
    required: true
    description: |
      Input codes to accelerate, usually INPUT_REL_X and INPUT_REL_Y. Each
      code is timed separately, since X and Y arrive as separate events in
      the same millisecond.

  slow-speed:
    type: int
    required: true
    description: |
      Speed at or below which the first cell (the minimum multiplier) is
      used. This is also what the speed estimate resets to after a pause, so
      a movement always starts at the fine step.

  fast-speed:
    type: int
    required: true
    description: |
      Speed at or above which the second cell (the maximum multiplier) is
      used. Must be greater than slow-speed. Between the two the multiplier
      ramps linearly.
```
