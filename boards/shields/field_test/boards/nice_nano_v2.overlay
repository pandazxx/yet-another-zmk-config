/*
 * Copyright (c) 2024 Field Test contributors
 * SPDX-License-Identifier: MIT
 *
 * nice!nano v2 (nRF52840) board-specific overrides.
 */

/* ── ADC channels for analog joystick ──────────────────────────────────── */

&adc {
    status = "okay";
    #address-cells = <1>;
    #size-cells = <0>;

    /* AIN4 / P0.28 — X-axis (pro_micro pin 20) */
    channel@4 {
        reg = <4>;
        zephyr,gain = "ADC_GAIN_1_6";
        zephyr,reference = "ADC_REF_INTERNAL";
        zephyr,acquisition-time = <ADC_ACQ_TIME_DEFAULT>;
        zephyr,input-positive = <NRF_SAADC_AIN4>;
        zephyr,resolution = <12>;
    };

    /* AIN6 / P0.30 — Y-axis (pro_micro pin 21) */
    channel@6 {
        reg = <6>;
        zephyr,gain = "ADC_GAIN_1_6";
        zephyr,reference = "ADC_REF_INTERNAL";
        zephyr,acquisition-time = <ADC_ACQ_TIME_DEFAULT>;
        zephyr,input-positive = <NRF_SAADC_AIN6>;
        zephyr,resolution = <12>;
    };
};
